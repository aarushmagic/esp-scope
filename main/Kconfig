## main/Kconfig
```kconfig
menu "espScope Configuration"

    config ESP_WIFI_SSID
        string "WiFi SSID"
        default "myssid"
        help
            SSID (network name) to connect to.

    config ESP_WIFI_PASSWORD
        string "WiFi Password"
        default "mypassword"
        help
            WiFi password.

endmenu
```

## sdkconfig.defaults
```kconfig
CONFIG_IDF_TARGET="esp32"
CONFIG_HTTPD_WS_SUPPORT=y
CONFIG_LED_BUILTIN=2
CONFIG_BSP_CONFIG_GPIO=0
CONFIG_ADC_CAL_EFUSE_TP_ENABLE=y
```
